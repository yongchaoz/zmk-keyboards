## boards/cyboard/assimilator-bt/Kconfig.defconfig
```kconfig
# SPDX-License-Identifier: MIT

if BOARD_ASSIMILATOR_BT

config BOARD
    default "assimilator-bt"
    select ZMK_BOARD_COMPAT

if USB_DEVICE_STACK

config USB_NRFX
    default y

endif # USB_DEVICE_STACK

config BT_CTLR
    default BT

endif # BOARD_ASSIMILATOR_BT
```
